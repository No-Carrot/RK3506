## buildroot/configs/rockchip_rk3506_defconfig
```kconfig
#include "base/base.config"
#include "chips/rk3506_arm.config"
BR2_ROOTFS_DEVICE_CREATION_DYNAMIC_DEVTMPFS=y
# BR2_ROOTFS_DEVICE_CREATION_DYNAMIC_EUDEV is not set
BR2_SYSTEM_BIN_SH_BUSYBOX=y
# BR2_SYSTEM_BIN_SH_BASH is not set
# BR2_PACKAGE_BASH is not set
# Audio is intentionally disabled on the EtherCAT controller image.
#include "gui/lvgl/lvgl_drm.config"
#include "gui/lvgl/motor_demo.config"
# BR2_PACKAGE_BRIDGE_UTILS is not set
# BR2_PACKAGE_CHRONY is reset to default
# BR2_PACKAGE_DNSMASQ is reset to default
# BR2_PACKAGE_DROPBEAR is reset to default
# BR2_PACKAGE_EVTEST is not set
# BR2_PACKAGE_EUDEV is not set
# BR2_PACKAGE_EUDEV_ENABLE_HWDB is not set
# BR2_PACKAGE_GDB is not set
# BR2_PACKAGE_GDB_DEBUGGER is not set
# BR2_PACKAGE_GDB_SERVER is not set
# BR2_PACKAGE_IPERF3 is not set
# BR2_PACKAGE_IPTABLES is not set
BR2_PACKAGE_BUSYBOX_SHOW_OTHERS=y
BR2_PACKAGE_BZIP2=y
# BR2_PACKAGE_ETHTOOL is not set
# BR2_PACKAGE_ETHTOOL_PRETTY_PRINT is not set
BR2_PACKAGE_KMOD=y
BR2_PACKAGE_KMOD_TOOLS=y
# BR2_PACKAGE_LIBCAP is not set
# BR2_PACKAGE_LIBGPIOD is not set
# BR2_PACKAGE_LIBGPIOD_TOOLS is not set
# BR2_PACKAGE_MHZ is not set
# BR2_PACKAGE_MOSQUITTO is not set
# BR2_PACKAGE_MTD is not set
# BR2_PACKAGE_NTP is not set
# BR2_PACKAGE_NTP_NTPDATE is not set
# BR2_PACKAGE_OPENSSH is not set
# BR2_PACKAGE_PAHO_MQTT_CPP is not set
# BR2_PACKAGE_PCRE2_32 is not set
# BR2_PACKAGE_PULSEAUDIO is reset to default
# BR2_PACKAGE_QT5 is not set
# BR2_PACKAGE_RECOVERY is not set
# BR2_PACKAGE_RECOVERY_NO_UI is not set
# BR2_PACKAGE_RECOVERY_USE_UPDATEENGINE is not set
# BR2_PACKAGE_RECOVERY_UPDATEENGINEBIN is not set
# BR2_PACKAGE_RIPGREP is not set
# BR2_PACKAGE_ROCKCHIP_RGA is not set
# BR2_PREFER_ROCKCHIP_RGA is not set
# BR2_PACKAGE_ROCKCHIP_TEST is not set
# BR2_PACKAGE_RT_TESTS is not set
# BR2_PACKAGE_STRESS is not set
# BR2_PACKAGE_STRESSAPPTEST is not set
# BR2_PACKAGE_CAN_UTILS is not set
# BR2_PACKAGE_USBUTILS is not set
# BR2_PACKAGE_USBMOUNT is not set
# BR2_PACKAGE_ALSA_LIB is not set
# BR2_PACKAGE_ALSA_UTILS is not set
# BR2_PACKAGE_ALSA_UCM_CONF is not set
# BR2_PACKAGE_E2FSPROGS is not set
# BR2_PACKAGE_E2FSPROGS_FSCK is not set
# BR2_PACKAGE_E2FSPROGS_RESIZE2FS is not set
# BR2_PACKAGE_FONTCONFIG is not set
# BR2_PACKAGE_LIBCURL is not set
# BR2_PACKAGE_NCURSES is not set
# BR2_PACKAGE_OPENSSL is not set
# BR2_PACKAGE_PULSEAUDIO is not set
# BR2_PACKAGE_PULSEAUDIO_DAEMON is not set
# BR2_PACKAGE_READLINE is not set
# BR2_PACKAGE_ROCKCHIP_ALSA_CONFIG is not set
# BR2_ROCKCHIP_ALSA_CONFIG_INSTALL_INIT_SCRIPT is not set
BR2_ROOTFS_OVERLAY+="board/rockchip/rk3506/fast-display-overlay/"
BR2_ROOTFS_POST_BUILD_SCRIPT+="board/rockchip/rk3506/post-build-fast-display.sh"
# BR2_TARGET_GENERIC_REMOUNT_ROOTFS_RW is not set
BR2_TARGET_LOCALTIME="Asia/Shanghai"
BR2_TARGET_ROOTFS_SQUASHFS4_ZSTD=y
BR2_TARGET_ROOTFS_UBI=y
BR2_TARGET_ROOTFS_UBIFS_LEBSIZE=0x1F000
BR2_TARGET_ROOTFS_UBIFS_MAXLEBCNT=1024
BR2_TARGET_ROOTFS_UBIFS_OPTS="-F -v"
BR2_TARGET_ROOTFS_UBI_SUBSIZE=2048
```

## buildroot/configs/rockchip_rk3506_emmc_defconfig
```kconfig
#include "base/base.config"
#include "chips/rk3506_arm.config"
#include "fs/vfat.config"
#include "wifibt/bt.config"
#include "wifibt/wireless.config"
#include "multimedia/audio.config"
#include "wifibt/bt.config"
#include "wifibt/wireless.config"
#include "gui/lvgl/lvgl_rkadk.config"
#include "gui/lvgl/rk_demo.config"
#include "fs/ntfs.config"
#include "bus/can.config"
# BR2_PACKAGE_CHRONY is reset to default
# BR2_PACKAGE_DNSMASQ is reset to default
# BR2_PACKAGE_DROPBEAR is reset to default
BR2_PACKAGE_EVTEST=y
BR2_PACKAGE_HOST_LINUX_HEADERS_CUSTOM_6_1=y
BR2_PACKAGE_LIBCAP=y
BR2_PACKAGE_MHZ=y
BR2_PACKAGE_MTD=y
# BR2_PACKAGE_PULSEAUDIO is reset to default
BR2_PACKAGE_RIPGREP=y
BR2_PACKAGE_RKADK_EXAMPLES=y
BR2_PACKAGE_ROCKCHIP_RGA=y
BR2_PACKAGE_ROCKCHIP_TEST=y
BR2_RK_DEMO_ENABLE_ASR=y
BR2_ROCKCHIP_ALSA_CONFIG_INSTALL_INIT_SCRIPT=y
BR2_ROOTFS_OVERLAY+="board/rockchip/rk3506/fast-display-overlay/"
BR2_ROOTFS_POST_BUILD_SCRIPT+="board/rockchip/rk3506/post-build-fast-display.sh"
# BR2_TARGET_GENERIC_REMOUNT_ROOTFS_RW is not set
#BR2_TARGET_ROOTFS_SQUASHFS4_ZSTD=y
#BR2_TARGET_ROOTFS_UBI=y
#BR2_TARGET_ROOTFS_UBI_SQUASHFS=y
# BR2_TARGET_ROOTFS_UBI_SQUASHFS_STATIC is not set
#BR2_TARGET_ROOTFS_UBIFS_LEBSIZE=0x1F000
#BR2_TARGET_ROOTFS_UBIFS_MAXLEBCNT=1024
#BR2_TARGET_ROOTFS_UBIFS_OPTS="-F -v"
#BR2_TARGET_ROOTFS_UBI_SUBSIZE=2048
BR2_PACKAGE_RECOVERY=y
BR2_PACKAGE_RECOVERY_NO_UI=y
BR2_PACKAGE_RECOVERY_USE_UPDATEENGINE=y
BR2_PACKAGE_RECOVERY_UPDATEENGINEBIN=y
#stress
BR2_PACKAGE_STRESS=y
#iperf3
BR2_PACKAGE_IPERF3=y
#iptables
BR2_PACKAGE_IPTABLES=y
#ssh
BR2_PACKAGE_OPENSSH=y
#lib gpiod
BR2_PACKAGE_LIBGPIOD=y
BR2_PACKAGE_LIBGPIOD_TOOLS=y
#iproute2
BR2_PACKAGE_IPROUTE2=y
#can
BR2_PACKAGE_CAN_UTILS=y
#mmc
BR2_PACKAGE_MMC_UTILS=y
#local time
BR2_TARGET_LOCALTIME="Asia/Shanghai"
#x264
BR2_PACKAGE_X264=y
#ffmpg
BR2_PACKAGE_FFMPEG=y
BR2_PACKAGE_FFMPEG_FFPLAY=y
#qt5
BR2_PACKAGE_PCRE2=y
BR2_PACKAGE_PCRE2_16=y
BR2_PACKAGE_PCRE2_32=y
BR2_PACKAGE_QT5=y
BR2_PACKAGE_QT5BASE_GUI=y
BR2_PACKAGE_QT5BASE_WIDGETS=y
BR2_PACKAGE_QT5BASE_DEFAULT_QPA=linuxfb
BR2_PACKAGE_QT5BASE_FONTCONFIG=y
BR2_PACKAGE_QT5BASE_JPEG=y
BR2_PACKAGE_QT5BASE_PNG=y
BR2_PACKAGE_QT5BASE_TSLIB=y
BR2_PACKAGE_QT5QUICKCONTROLS=y
BR2_PACKAGE_QT5QUICKCONTROLS2=y
BR2_PACKAGE_QT5VIRTUALKEYBOARD=y
BR2_PACKAGE_QT5CHARTS=y
#mqtt
BR2_PACKAGE_MOSQUITTO=y
BR2_PACKAGE_PAHO_MQTT_C=y
BR2_PACKAGE_PAHO_MQTT_CPP=y
#rt linux
BR2_PACKAGE_RT_TESTS=y

BR2_PACKAGE_EUDEV_RULES=y
BR2_PACKAGE_USBUTILS=y

R2_PACKAGE_EVTEST=y
BR2_PACKAGE_LRZSZ=y
BR2_PACKAGE_PROCRANK_LINUX=y
BR2_PACKAGE_I2C_TOOLS=y
BR2_PACKAGE_STRACE=y
BR2_PACKAGE_IPUTILS=y
BR2_PACKAGE_IW=y
BR2_PACKAGE_WIRELESS_TOOLS=y
BR2_PACKAGE_ROCKCHIP_TEST=y
BR2_PACKAGE_PROCPS_NG=y
BR2_PACKAGE_ROCKCHIP_MPP_TESTS=y
#bridge
BR2_PACKAGE_BRIDGE_UTILS=y
#gdb
BR2_PACKAGE_GDB=y
BR2_PACKAGE_GDB_DEBUGGER=y
BR2_PACKAGE_GDB_SERVER=y
#ntp
BR2_PACKAGE_NTP=y
BR2_PACKAGE_NTP_NTPDATE=y
#rkwifibt-app
BR2_TOOLCHAIN_GLIBC_GCONV_LIBS_COPY=y
#v4l2
BR2_PACKAGE_LIBV4L=y
BR2_PACKAGE_LIBV4L_UTILS=y
BR2_PACKAGE_LIBV4L_BUILTIN_PLUGINS=y
```

## buildroot/configs/rockchip_rk3576_cluster_defconfig
```kconfig
#include "base/base.config"
#include "bus/can.config"
#include "bus/pci.config"
#include "chips/rk3576_aarch64.config"
#include "font/chinese.config"
#include "fs/exfat.config"
#include "fs/ntfs.config"
#include "fs/vfat.config"
#include "base/base.config"
#include "gpu/gpu.config"
#include "gui/weston.config"
#include "network/network.config"
#include "tools/benchmark.config"
#include "tools/common.config"
#include "tools/test.config"
#include "network/chromium.config"
BR2_GDB_VERSION_12=y
BR2_PACKAGE_ALSA_PLUGINS=y
BR2_PACKAGE_ALSA_UCM_CONF=y
BR2_PACKAGE_ALSA_UTILS=y
BR2_PACKAGE_ALSA_UTILS_ALSACONF=y
BR2_PACKAGE_ALSA_UTILS_AMIXER=y
BR2_PACKAGE_ALSA_UTILS_APLAY=y
BR2_PACKAGE_BRIDGE_UTILS=y
BR2_PACKAGE_ETHTOOL=y
BR2_PACKAGE_GDB=y
BR2_PACKAGE_GDB_DEBUGGER=y
BR2_PACKAGE_HOST_GDB=y
BR2_PACKAGE_IPERF3=y
BR2_PACKAGE_LIBV4L=y
BR2_PACKAGE_LIBV4L_UTILS=y
BR2_PACKAGE_PANGO=y
BR2_PACKAGE_RECOVERY=y
BR2_PACKAGE_RECOVERY_BOOTCONTROL=y
BR2_PACKAGE_RECOVERY_RETRY=y
BR2_PACKAGE_RECOVERY_USE_UPDATEENGINE=y
BR2_PACKAGE_ROCKCHIP_RGA=y
BR2_PACKAGE_ROCKCHIP_RVCAM=y
BR2_PACKAGE_WESTON_DEFAULT_PIXMAN=y
# BR2_PACKAGE_WESTON_DEMO_CLIENTS is reset to default
# BR2_PACKAGE_WESTON_SCREENSHARE is not set
# BR2_PACKAGE_WESTON_SHELL_FULLSCREEN is not set
# BR2_PACKAGE_WESTON_SHELL_IVI is not set
# BR2_PACKAGE_WESTON_SHELL_KIOSK is not set
# BR2_PACKAGE_WESTON_SIMPLE_CLIENTS is reset to default
BR2_PREFER_ROCKCHIP_RGA=y
BR2_ROOTFS_OVERLAY+="board/rockchip/rk3576/fs-overlay-cluster/"
BR2_SYSTEM_BIN_SH_BUSYBOX=y
```

## buildroot/configs/rockchip_rk3576_cvr_defconfig
```kconfig
#include "base/base.config"
#include "chips/rk3576_aarch64.config"
#include "fs/exfat.config"
#include "fs/vfat.config"
#include "gpu/gpu.config"
#include "multimedia/audio.config"
#include "multimedia/camera.config"
#include "multimedia/mpp.config"
#include "products/ipc.config"
#include "npu2.config"
BR2_LV_COLOR_DEPTH_32=y
BR2_LV_COLOR_SCREEN_TRANSP=y
BR2_LV_FONT_DEFAULT_MONTSERRAT_24=y
BR2_LV_MEM_SIZE_KILOBYTES=128
BR2_LV_PERF_MONITOR_ALIGN_TOP_LEFT=y
BR2_LV_USE_FREETYPE=y
BR2_LV_USE_LARGE_COORD=y
BR2_LV_USE_MEM_MONITOR=y
BR2_LV_USE_PERF_MONITOR=y
BR2_LV_USE_PNG=y
BR2_PACKAGE_CAMERA_ENGINE_RKAIQ_INSTALL_AIISP=y
BR2_PACKAGE_CVR_APP=y
BR2_PACKAGE_CVR_FILE_CACHE=y
BR2_PACKAGE_CVR_LVGL=y
BR2_PACKAGE_CVR_RK3576=y
BR2_PACKAGE_CVR_USE_AIQ=y
BR2_PACKAGE_FCGIWRAP=y
# BR2_PACKAGE_IPCWEB_BACKEND is reset to default
# BR2_PACKAGE_IVA is reset to default
BR2_PACKAGE_JSON_FOR_MODERN_CPP=y
BR2_PACKAGE_LIBCGICC=y
BR2_PACKAGE_LIBDRM_INSTALL_TESTS=y
BR2_PACKAGE_LIBGLIB2=y
BR2_PACKAGE_LIBPNG=y
BR2_PACKAGE_LIBUNWIND=y
BR2_PACKAGE_RKADK_COMMON_FUNCTIONS=y
BR2_PACKAGE_RKADK_DISPLAY=y
BR2_PACKAGE_RKADK_EXAMPLES=y
BR2_PACKAGE_RKADK_FILE_CACHE=y
BR2_PACKAGE_RKADK_PLAYER=y
BR2_PACKAGE_RKADK_STORAGE=y
BR2_PACKAGE_RKADK_USE_AIQ=y
# BR2_PACKAGE_RKIPC is reset to default
BR2_PACKAGE_ROCKCHIP_RGA=y
# BR2_PACKAGE_SAMPLES is reset to default
BR2_PACKAGE_WPA_SUPPLICANT=y
BR2_ROOTFS_OVERLAY="board/rockchip/common/base board/rockchip/rk3576/fs-overlay-ipc/"
```

## buildroot/package/rockchip/rockchip-mali/Config.in
```kconfig
config BR2_PACKAGE_ROCKCHIP_MALI_SUPPORT
	bool

config BR2_PACKAGE_ROCKCHIP_MALI
	bool "rockchip-mali"
	depends on BR2_PACKAGE_ROCKCHIP_MALI_SUPPORT
	depends on BR2_INSTALL_LIBSTDCPP
	depends on BR2_TOOLCHAIN_USES_GLIBC
	depends on BR2_TOOLCHAIN_HAS_THREADS
	depends on BR2_aarch64 || (BR2_ARM_EABIHF && BR2_arm)
	select BR2_PACKAGE_LIBDRM
	help
	  Install the binary user-space components for the ARM Mali GPU.
	  This package requires a kernel with the ARM Mali GPU Kernel
	  Drivers enabled.

config BR2_PACKAGE_ROCKCHIP_MALI_UTGARD_400
	bool
	select BR2_PACKAGE_ROCKCHIP_MALI_SUPPORT

config BR2_PACKAGE_ROCKCHIP_MALI_UTGARD_450
	bool
	select BR2_PACKAGE_ROCKCHIP_MALI_SUPPORT

config BR2_PACKAGE_ROCKCHIP_MALI_MIDGARD_T76X
	bool
	select BR2_PACKAGE_ROCKCHIP_MALI_SUPPORT

config BR2_PACKAGE_ROCKCHIP_MALI_MIDGARD_T86X
	bool
	select BR2_PACKAGE_ROCKCHIP_MALI_SUPPORT

config BR2_PACKAGE_ROCKCHIP_MALI_BIFROST_G31
	bool
	select BR2_PACKAGE_ROCKCHIP_MALI_SUPPORT

config BR2_PACKAGE_ROCKCHIP_MALI_BIFROST_G52
	bool
	select BR2_PACKAGE_ROCKCHIP_MALI_SUPPORT

config BR2_PACKAGE_ROCKCHIP_MALI_VALHALL_G610
	bool
	select BR2_PACKAGE_ROCKCHIP_MALI_SUPPORT

if BR2_PACKAGE_ROCKCHIP_MALI

config BR2_PACKAGE_ROCKCHIP_MALI_GPU
        string
        default "utgard-400" if BR2_PACKAGE_ROCKCHIP_MALI_UTGARD_400
        default "utgard-450" if BR2_PACKAGE_ROCKCHIP_MALI_UTGARD_450
        default "midgard-t76x" if BR2_PACKAGE_ROCKCHIP_MALI_MIDGARD_T76X
        default "midgard-t86x" if BR2_PACKAGE_ROCKCHIP_MALI_MIDGARD_T86X
        default "bifrost-g31" if BR2_PACKAGE_ROCKCHIP_MALI_BIFROST_G31
        default "bifrost-g52" if BR2_PACKAGE_ROCKCHIP_MALI_BIFROST_G52
        default "valhall-g610" if BR2_PACKAGE_ROCKCHIP_MALI_VALHALL_G610

config BR2_PACKAGE_ROCKCHIP_MALI_VERSION
	string "version"
	default "r7p0" if BR2_PACKAGE_ROCKCHIP_MALI_UTGARD_400
	default "r7p0" if BR2_PACKAGE_ROCKCHIP_MALI_UTGARD_450
	default "r18p0" if BR2_PACKAGE_ROCKCHIP_MALI_MIDGARD_T76X
	default "r18p0" if BR2_PACKAGE_ROCKCHIP_MALI_MIDGARD_T86X
	default "g24p0" if BR2_PACKAGE_ROCKCHIP_MALI_BIFROST_G31
	default "g24p0" if BR2_PACKAGE_ROCKCHIP_MALI_BIFROST_G52
	default "g24p0" if BR2_PACKAGE_ROCKCHIP_MALI_VALHALL_G610

config BR2_PACKAGE_ROCKCHIP_MALI_SUB_VERSION
	string "sub version"
	default "r3p0" if BR2_PACKAGE_ROCKCHIP_MALI_UTGARD_400
	default "r1p1" if BR2_PACKAGE_ROCKCHIP_MALI_UTGARD_450

choice
	prompt "optimize level"
	default BR2_PACKAGE_ROCKCHIP_MALI_OPTIMIZE_3
	help
	  Set the optimization level for rockchip-mali

config BR2_PACKAGE_ROCKCHIP_MALI_OPTIMIZE_3
	bool "optimization level 3"
	help
	  Built with -O3.

config BR2_PACKAGE_ROCKCHIP_MALI_OPTIMIZE_s
	bool "optimization level s"
	help
	  Built with -Os.

endchoice

config BR2_PACKAGE_ROCKCHIP_MALI_CUSTOM_PLATFORM
	string "custom platform"
	default ""

config BR2_PACKAGE_ROCKCHIP_MALI_HAS_DUMMY
	bool "dummy winsys"
	help
	  For dummy platform.

config BR2_PACKAGE_ROCKCHIP_MALI_HAS_WAYLAND
	bool "wayland winsys"
	default y
	depends on BR2_PACKAGE_WAYLAND
	help
	  For wayland platform.

config BR2_PACKAGE_ROCKCHIP_MALI_HAS_X11
	bool "X11 winsys"
	default y
	depends on BR2_PACKAGE_XORG7
	select BR2_PACKAGE_LIBXCB
	select BR2_PACKAGE_XLIB_LIBX11
	help
	  For X11 platform.

config BR2_PACKAGE_ROCKCHIP_MALI_HAS_GBM
	bool "GBM"
	default y if !BR2_PACKAGE_ROCKCHIP_MALI_HAS_DUMMY
	select BR2_PACKAGE_HAS_LIBGBM
	select BR2_PACKAGE_LIBGBM_HAS_FEATURE_FORMAT_MODIFIER_PLANE_COUNT
	select BR2_PACKAGE_LIBGBM_HAS_FEATURE_DMA_BUF
	help
	  For GBM platform.

config BR2_PACKAGE_ROCKCHIP_MALI_HAS_EGL
	bool "OpenGL EGL"
	default y
	select BR2_PACKAGE_HAS_LIBEGL

config BR2_PACKAGE_ROCKCHIP_MALI_HAS_EGL_WAYLAND
	bool "OpenGL EGL Wayland"
	default y
	depends on BR2_PACKAGE_ROCKCHIP_MALI_HAS_EGL
	depends on BR2_PACKAGE_ROCKCHIP_MALI_HAS_WAYLAND
	select BR2_PACKAGE_HAS_LIBEGL_WAYLAND

config BR2_PACKAGE_ROCKCHIP_MALI_HAS_GLES
	bool "OpenGL ES"
	default y
	select BR2_PACKAGE_HAS_LIBGLES

config BR2_PACKAGE_ROCKCHIP_MALI_HAS_OPENCL
	bool "OpenCL"
	default y
	select BR2_PACKAGE_HAS_LIBOPENCL

config BR2_PACKAGE_ROCKCHIP_MALI_HAS_VULKAN
	bool "Vulkan"
	select BR2_PACKAGE_VULKAN_LOADER

config BR2_PACKAGE_PROVIDES_LIBEGL
	default "rockchip-mali" if BR2_PACKAGE_ROCKCHIP_MALI_HAS_EGL

config BR2_PACKAGE_PROVIDES_LIBGBM
	default "rockchip-mali" if BR2_PACKAGE_ROCKCHIP_MALI_HAS_GBM

config BR2_PACKAGE_PROVIDES_LIBGLES
	default "rockchip-mali" if BR2_PACKAGE_ROCKCHIP_MALI_HAS_GLES

config BR2_PACKAGE_PROVIDES_LIBOPENCL
	default "rockchip-mali" if BR2_PACKAGE_ROCKCHIP_MALI_HAS_OPENCL

endif
```
