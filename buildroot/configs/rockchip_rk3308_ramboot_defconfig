## buildroot/configs/rockchip_rk3576_dv_defconfig
```kconfig
#include "rockchip_rk3576_ipc_defconfig"
#include "fs/ubifs.config"
#include "gui/lvgl/v8/base.config"
# BR2_PACKAGE_CAMERA_ENGINE_RKAIQ_INSTALL_AIISP is reset to default
BR2_PACKAGE_HOST_E2FSPROGS=y
# BR2_PACKAGE_IPCWEB_BACKEND is reset to default
# BR2_PACKAGE_IVA is reset to default
BR2_PACKAGE_LIBATOMIC_OPS=y
BR2_PACKAGE_LIBGLIB2=y
BR2_PACKAGE_LIBPNG=y
BR2_PACKAGE_LIBUNWIND=y
BR2_PACKAGE_LV_DRIVERS=y
# BR2_PACKAGE_NGINX is reset to default
BR2_PACKAGE_RKIPC_RK3576_DV=y
BR2_PACKAGE_ROCKCHIP_MALI_CUSTOM_PLATFORM="minicl"
# BR2_PACKAGE_ROCKCHIP_MALI_HAS_DUMMY is reset to default
# BR2_PACKAGE_ROCKCHIP_MALI_HAS_EGL is not set
# BR2_PACKAGE_ROCKCHIP_MALI_HAS_GBM is not set
# BR2_PACKAGE_ROCKCHIP_MALI_HAS_GLES is not set
BR2_PACKAGE_ROCKCHIP_MALI_OPTIMIZE_s=y
BR2_PACKAGE_ROCKCHIP_MALI_VERSION="g13p0"
# BR2_PACKAGE_SAMPLES is reset to default
BR2_ROOTFS_POST_BUILD_SCRIPT+="board/rockchip/rk3576/post-build-dv.sh"
# BR2_TARGET_ROOTFS_EXT2 is reset to default
```

## buildroot/configs/rockchip_rv1126_rv1109_defconfig
```kconfig
#include "base/base.config"
#include "chips/rv1126_rv1109_arm.config"
#include "fs/vfat.config"
#include "multimedia/audio.config"
#include "multimedia/camera.config"
#include "multimedia/mpp.config"
#include "multimedia/rockit.config"
BR2_PACKAGE_LIBDRM=y
BR2_PACKAGE_LIBDRM_INSTALL_TESTS=y
BR2_PACKAGE_ROCKCHIP_RGA=y
BR2_PACKAGE_CAMERA_ENGINE_RKAIQ_RKISP_DEMO=y
BR2_PACKAGE_RKNPU=y
```

## buildroot/package/flutter-embedded-linux/Config.in
```kconfig
menuconfig BR2_PACKAGE_FLUTTER_EMBEDDED_LINUX
	bool "flutter-embedded-linux"
	depends on BR2_PACKAGE_HOST_FLUTTER_SDK_BIN_ARCH_SUPPORTS
	depends on BR2_PACKAGE_FLUTTER_ENGINE_ARCH_SUPPORTS
	depends on BR2_HOST_GCC_AT_LEAST_5 # flutter-engine
	depends on BR2_TOOLCHAIN_GCC_AT_LEAST_5 # flutter-engine
	depends on !BR2_TOOLCHAIN_HAS_GCC_BUG_64735 # flutter-engine
	depends on BR2_TOOLCHAIN_USES_GLIBC # flutter-engine
	depends on BR2_INSTALL_LIBSTDCPP # flutter-engine
	depends on !BR2_STATIC_LIBS # flutter-engine, wayland
	depends on BR2_USE_WCHAR # flutter-engine
	depends on BR2_PACKAGE_HAS_LIBGLES # flutter-engine
	select BR2_PACKAGE_HOST_FLUTTER_SDK_BIN
	select BR2_PACKAGE_FLUTTER_ENGINE
	select BR2_PACKAGE_LIBXKBCOMMON
	select BR2_PACKAGE_LIBDRM
	help
	  Embedded Linux embedding for Flutter.

	  https://github.com/sony/flutter-embedded-linux

if BR2_PACKAGE_FLUTTER_EMBEDDED_LINUX

choice
	prompt "backend"

config BR2_PACKAGE_FLUTTER_EMBEDDED_LINUX_WAYLAND
	bool "wayland"
	depends on BR2_PACKAGE_WAYLAND

config BR2_PACKAGE_FLUTTER_EMBEDDED_LINUX_X11
	bool "x11"
	depends on BR2_PACKAGE_XORG7

config BR2_PACKAGE_FLUTTER_EMBEDDED_LINUX_GBM
	bool "gbm"
	depends on BR2_PACKAGE_HAS_LIBGBM
	depends on BR2_PACKAGE_SYSTEMD

endchoice

config BR2_PACKAGE_FLUTTER_EMBEDDED_LINUX_CLIENT
	bool "client example"

endif
```

## buildroot/package/mimalloc/Config.in
```kconfig
config BR2_PACKAGE_MIMALLOC
	bool "mimalloc"
	depends on BR2_TOOLCHAIN_HAS_THREADS
	help
	  Mimalloc is a compact general purpose allocator with excellent
	  performance.

	  https://github.com/microsoft/mimalloc

if BR2_PACKAGE_MIMALLOC

config BR2_PACKAGE_MIMALLOC_STATIC_ONLY
	bool "static only"
	default y

endif
```

## buildroot/package/popt/Config.in
```kconfig
config BR2_PACKAGE_POPT
	bool "popt"
	help
	  Popt is a C library for parsing command line parameters.

	  https://github.com/rpm-software-management/popt

if BR2_PACKAGE_POPT

config BR2_PACKAGE_POPT_STATIC
	bool "Enable static"
	default y if BR2_STATIC_LIBS

endif
```

## buildroot/package/rockchip/cvr_app/Config.in
```kconfig
config BR2_PACKAGE_CVR_APP
        bool "cvr app"
        select BR2_PACKAGE_RKADK
        select BR2_PACKAGE_RKFSMK
        select BR2_PACKAGE_ROCKIT
        default n
        help
                cvr app
if BR2_PACKAGE_CVR_APP

config BR2_PACKAGE_CVR_USE_AIQ


        bool "camera capture with rkaiq api"
        select BR2_PACKAGE_CAMERA_ENGINE_RKAIQ
        default n
        help
                camera capture with rkaiq api

config BR2_PACKAGE_CVR_FILE_CACHE
        bool "file cache"
        default n
        help
                enable file cache

config BR2_PACKAGE_CVR_LVGL
        bool "lvgl"
        select BR2_PACKAGE_LVGL
        default n
        help
                enable lvgl

choice
        prompt "SOC Type"
        default BR2_PACKAGE_CVR_RV1106

config BR2_PACKAGE_CVR_RV1103B
        bool "RV1103B"
        help
                Enable RV1103B specific features

config BR2_PACKAGE_CVR_RV1126
        bool "RV1126"
        help
                Enable RV1126 specific features

config BR2_PACKAGE_CVR_RK3576
        bool "RK3576"
        help
                Enable RK3576 specific features

config BR2_PACKAGE_CVR_RV1106
        bool "RV1106"
        help
                Enable RV1106 specific features

endchoice

endif # BR2_PACKAGE_CVR_APP
```

## buildroot/package/rockchip/rkpartybox/Config.in
```kconfig
config BR2_PACKAGE_RKPARTYBOX
	bool "RKPARTYBOX demo"
	depends on BR2_aarch64
	depends on BR2_PACKAGE_HAS_UDEV
	help
	  rkpartybox demo

config BR2_PACKAGE_RK3308_RKPARTYBOX_BTMCU
	bool "RKPARTYBOX use BTMCU"
	depends on BR2_PACKAGE_RKPARTYBOX
	help
	  partybox use external BT soc

config BR2_PACKAGE_PBOX_LCD_DISPLAY
	bool "RKPARTYBOX LCD display"
	depends on BR2_PACKAGE_RKPARTYBOX
	depends on BR2_PACKAGE_LVGL
	depends on BR2_PACKAGE_LV_DRIVERS
	depends on BR2_PACKAGE_WPA_SUPPLICANT
	select BR2_PACKAGE_LIBEVDEV
	default y
	help
	  partybox lcd display

config BR2_PACKAGE_PBOX_LED_EFFECT
	bool "RKPARTYBOX led effect"
	depends on BR2_PACKAGE_RKPARTYBOX
	default y
	help
	  partybox led effect demo
```

## buildroot/package/rockchip/rockchip-rvcam/Config.in
```kconfig
config BR2_PACKAGE_ROCKCHIP_RVCAM
	bool "rockchip-rvcam"
	select BR2_PACKAGE_ROCKCHIP_ERPC
	select BR2_PACKAGE_TINYXML2
	help
	  This option activates the Rockchip Vehicle Camera (RVCAM)
	  middleware solution, delivering a reliable virtual
	  multi-camera capability. This feature is designed to
	  enhance Automotive Camera HAL3 and EVS HAL, along with
	  other native applications.
```
